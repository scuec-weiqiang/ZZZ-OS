## arch/riscv64/config/defconfig
```kconfig
CONFIG_ARCH_RISCV64 = y

CONFIG_ARCH_PLIC = y

CONFIG_VIRTIO = y
CONFIG_SERIAL_16550 = y
CONFIG_QEMU_FW_CFG = y
CONFIG_TEST_I2C = y
CONFIG_EXT2 = y
CONFIG_RAMFS = y
CONFIG_VIRT_BLK = y


CONFIG_BLK_READ_BENCH = y
CONFIG_TEST_MM_ALLOCATOR = y
CONFIG_TEST_MM_BENCH = y
CONFIG_TEST_MM_FRAGMENTATION = y
CONFIG_TEST_BLOCK_IO = y
CONFIG_TEST_FS_READ = y
CONFIG_TEST_MEMORY_USAGE = y
```
