## arch/arm/config/defconfig
```kconfig
CONFIG_ARCH_ARM = y

CONFIG_IMX6ULL_GIC = y

CONFIG_IMX6ULL_UART = y
CONFIG_IMX6ULL_LED = y

CONFIG_MEM_DISK = y
CONFIG_IMX6ULL_RTC = n

CONFIG_GPIO_MXC = y

CONFIG_EXT2 = y
CONFIG_RAMFS = y
```
